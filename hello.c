#define F_CPU 16000000UL // Adjust to your crystal frequency
#include <avr/io.h>
#include <util/delay.h>
#include <avr/pgmspace.h>
#include <stdint.h>

// SPI and Control Pin Definitions
#define TFT_PORT_SPI PORTB
#define TFT_DDR_SPI  DDRB
#define CS           4 // PB4
#define MOSI         5 // PB5
#define SCK          7 // PB7

#define TFT_PORT_CTRL PORTD
#define TFT_DDR_CTRL  DDRD
#define DC           2 // PD2
#define RST          3 // PD3

#define BLACK 0x0000
#define WHITE 0xFFFF

// Standard 5x7 Font Array (ASCII 32-127) stored in Flash
const uint8_t font5x7[96][5] PROGMEM = {
    {0x00, 0x00, 0x00, 0x00, 0x00}, {0x00, 0x00, 0x4f, 0x00, 0x00}, {0x00, 0x07, 0x00, 0x07, 0x00}, {0x14, 0x7f, 0x14, 0x7f, 0x14},
    {0x24, 0x2a, 0x7f, 0x2a, 0x12}, {0x23, 0x13, 0x08, 0x64, 0x62}, {0x36, 0x49, 0x55, 0x22, 0x50}, {0x00, 0x05, 0x03, 0x00, 0x00},
    {0x00, 0x1c, 0x22, 0x41, 0x00}, {0x00, 0x41, 0x22, 0x1c, 0x00}, {0x14, 0x08, 0x3e, 0x08, 0x14}, {0x08, 0x08, 0x3e, 0x08, 0x08},
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    {0x00, 0x00, 0x7f, 0x00, 0x00}, {0x00, 0x41, 0x36, 0x08, 0x00}, {0x10, 0x08, 0x08, 0x10, 0x08}, {0x00, 0x00, 0x00, 0x00, 0x00}
};

void SPI_Init() {
    TFT_DDR_SPI |= (1<<MOSI) | (1<<SCK) | (1<<CS);
    TFT_DDR_CTRL |= (1<<RST) | (1<<DC);
    SPCR = (1<<SPE) | (1<<MSTR);
    SPSR = (1<<SPI2X);
    TFT_PORT_SPI |= (1<<CS); 
}

void SPI_Write(uint8_t data) {
    SPDR = data;
    while(!(SPSR & (1<<SPIF)));
}

void TFT_Command(uint8_t cmd) {
    TFT_PORT_CTRL &= ~(1<<DC);
    TFT_PORT_SPI &= ~(1<<CS);
    SPI_Write(cmd);
    TFT_PORT_SPI |= (1<<CS);
}

void TFT_Data(uint8_t data) {
    TFT_PORT_CTRL |= (1<<DC);
    TFT_PORT_SPI &= ~(1<<CS);
    SPI_Write(data);
    TFT_PORT_SPI |= (1<<CS);
}

void TFT_Init() {
    TFT_PORT_CTRL &= ~(1<<RST);
    _delay_ms(50);
    TFT_PORT_CTRL |= (1<<RST);
    _delay_ms(50);

    TFT_Command(0x11); // Sleep Out
    _delay_ms(150);
    TFT_Command(0x3A); // Color Mode
    TFT_Data(0x05);    // 16-bit color (RGB565)
    TFT_Command(0x36); // Memory Data Access Control (Orientation)
    TFT_Data(0xC0);    // Adjust this hex if your screen draws upside down
    TFT_Command(0x29); // Display ON
}

void TFT_SetWindow(uint8_t x0, uint8_t y0, uint8_t x1, uint8_t y1) {
    TFT_Command(0x2A); TFT_Data(0); TFT_Data(x0); TFT_Data(0); TFT_Data(x1);
    TFT_Command(0x2B); TFT_Data(0); TFT_Data(y0); TFT_Data(0); TFT_Data(y1);
    TFT_Command(0x2C); 
}

// Fills entire screen with a specific 16-bit color
void TFT_FillScreen(uint16_t color) {
    TFT_SetWindow(0, 0, 127, 159);
    uint8_t high = color >> 8;
    uint8_t low = color & 0xFF;
    
    TFT_PORT_CTRL |= (1<<DC);
    TFT_PORT_SPI &= ~(1<<CS);
    for(uint16_t i = 0; i < 20480; i++) {
        SPI_Write(high);
        SPI_Write(low);
    }
    TFT_PORT_SPI |= (1<<CS);
}

// Draws a single character using the PROGMEM font array
void TFT_DrawChar(uint8_t x, uint8_t y, char c, uint16_t color, uint16_t bg) {
    if ((x > 127 - 5) || (y > 159 - 8)) return; // Bounds check
    
    for (uint8_t i = 0; i < 5; i++) {
        uint8_t line = pgm_read_byte(&font5x7[c - 32][i]);
        for (uint8_t j = 0; j < 8; j++) {
            if (line & 0x1) {
                TFT_SetWindow(x + i, y + j, x + i, y + j);
                TFT_Data(color >> 8); TFT_Data(color & 0xFF);
            } else {
                TFT_SetWindow(x + i, y + j, x + i, y + j);
                TFT_Data(bg >> 8); TFT_Data(bg & 0xFF);
            }
            line >>= 1;
        }
    }
}

// Iterates through a string to draw multiple characters
void TFT_DrawString(uint8_t x, uint8_t y, const char *str, uint16_t color, uint16_t bg) {
    while (*str) {
        TFT_DrawChar(x, y, *str, color, bg);
        x += 6; // Move cursor right by 6 pixels (5px font + 1px spacing)
        if (x > 127 - 5) { // Simple line wrapping
            x = 0;
            y += 8;
        }
        str++;
    }
}

int main(void) {
    SPI_Init();
    TFT_Init();
    
    TFT_FillScreen(BLACK);
    
    // Draw "Hello world" at X=10, Y=20 with WHITE text on BLACK background
    TFT_DrawString(10, 20, "Hello world", WHITE, BLACK);

    while(1) {
        // Main infinite loop
    }
}